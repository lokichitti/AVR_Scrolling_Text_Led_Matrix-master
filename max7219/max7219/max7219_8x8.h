 
#ifndef F_CPU
#define F_CPU 8000000UL
#endif

#include <avr/io.h>
#include <util/delay.h>
#include <avr/pgmspace.h>

// Macros to set SS line LOW (selected) or HIGH (deselected)
#define SLAVE_SELECT    PORTB &= ~(1 << PB0)
#define SLAVE_DESELECT  PORTB |= (1 << PB0)

// Array holding arrays of 5 Bytes for each representation of an ASCII character, stored in flash 
const char characters[96][6] PROGMEM ={
	{0x00,0x00,0x00,0x00,0x00,0x00},    // SPACE
	{0x00,0x00,0x00,0x4F,0x00,0x00},    // !
	{0x00,0x00,0x07,0x00,0x07,0x00},    // "
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	{0x00,0x0C,0x02,0x0C,0x10,0x0C}     // ~
};
// Message to be displayed, stored in flash
const char message[] PROGMEM = "    Alice's Adventures In Wonderland                  By Lewis Carroll                Chapter I: Down the Rabbit-Hole         \
Just then her head struck against the roof of the hall: in fact she was now more than nine feet high, and she at once took up the little golden key and hurried off to the garden door. \
Just then she heard something splashing about in the pool a little way off, and she swam nearer to make out what it was: at first she thought it must be a walrus or hippopotamus, but then she remembered how small she was now, and she soon made out that it was only a mouse that had slipped in like herself. \
\'Would it be of any use, now,\' thought Alice, \'to speak to this mouse? Everything is so out-of-the-way down here, that I should think very likely it can talk: at any rate, there\'s no harm in trying.\' So she began: \'O Mouse, do you know the way out of this pool? I am very tired of swimming about here, O Mouse!\' (Alice thought this must be the right way of speaking to a mouse: she had never done such a thing before, but she remembered having seen in her brother\'s Latin Grammar, \'A mouse-of a mouse-to a mouse-a mouse-O mouse!\') The Mouse looked at her rather inquisitively, and seemed to her to wink with one of its little eyes, but it said nothing. \
\'Perhaps it doesn\'t understand English,\' thought Alice; \'I daresay it\'s a French mouse, come over with William the Conqueror.\' (For, with all her knowledge of history, Alice had no very clear notion how long ago anything had happened.) So she began again: \'Ou est ma chatte?\' which was the first sentence in her French lesson-book. The Mouse gave a sudden leap out of the water, and seemed to quiver all over with fright. \'Oh, I beg your pardon!\' cried Alice hastily, afraid that she had hurt the poor animal\'s feelings. \'I quite forgot you didn\'t like cats.\' \
\'Not like cats!\' cried the Mouse, in a shrill, passionate voice. \'Would you like cats if you were me?\' \
\'Well, perhaps not,\' said Alice in a soothing tone: \'don\'t be angry about it. And yet I wish I could show you our cat Dinah: I think you\'d take a fancy to cats if you could only see her. She is such a dear quiet thing,\' Alice went on, half to herself, as she swam lazily about in the pool, \'and she sits purring so nicely by the fire, licking her paws and washing her face-and she is such a nice soft thing to nurse-and she\'s such a capital one for catching mice-oh, I beg your pardon!\' cried Alice again, for this time the Mouse was bristling all over, and she felt certain it must be really offended. \'We won\'t talk about her any more if you\'d rather not.\' \
\'We indeed!\' cried the Mouse, who was trembling down to the end of his tail. \'As if I would talk on such a subject! Our family always hated cats: nasty, low, vulgar things! Don\'t let me hear the name again!\' \
\'I won\'t indeed!\' said Alice, in a great hurry to change the subject of conversation. \'Are you-are you fond-of-of dogs?\' The Mouse did not answer, so Alice went on eagerly: \'There is such a nice little dog near our house I should like to show you! A little bright-eyed terrier, you know, with oh, such long curly brown hair! And it\'ll fetch things when you throw them, and it\'ll sit up and beg for its dinner, and all sorts of things-I can\'t remember half of them-and it belongs to a farmer, you know, and he says it\'s so useful, it\'s worth a hundred pounds! He says it kills all the rats and-oh dear!\' cried Alice in a sorrowful tone, \'I\'m afraid I\'ve offended it again!\' For the Mouse was swimming away from her as hard as it could go, and making quite a commotion in the pool as it went. \
So she called softly after it, \'Mouse dear! Do come back again, and we won\'t talk about cats or dogs either, if you don\'t like them!\' When the Mouse heard this, it turned round and swam slowly back to her: its face was quite pale (with passion, Alice thought), and it said in a low trembling voice, \'Let us get to the shore, and then I\'ll tell you my history, and you\'ll understand why it is I hate cats and dogs.\' \
dadas\
It was high time to go, for the pool was getting quite crowded with the birds and animals that had fallen into it: there were a Duck and a Dodo, a Lory and an Eaglet, and several other curious creatures. Alice led the way, and the whole party swam to the shore.            ";

// Function Prototypes

void initSPI(void);

void writeByte(uint8_t byte);

void writeWord(uint8_t address, uint8_t data);
  
void initMatrix(void);

void clearMatrix(void);

void initBuffer(void);

void pushBuffer(uint8_t x);

void pushCharacter(uint8_t c);

void displayMessage(const char *arrayPointer, uint16_t arraySize);

void displayBuffer(void);

